## Config.in
```kconfig
source "$BR2_EXTERNAL_MORDERCA_TREE_PATH/package/dyndns-updater/Config.in"
source "$BR2_EXTERNAL_MORDERCA_TREE_PATH/package/grepcidr/Config.in"
source "$BR2_EXTERNAL_MORDERCA_TREE_PATH/package/pivpn/Config.in"
```

## package/dyndns-updater/Config.in
```kconfig
config BR2_PACKAGE_DYNDNS_UPDATER
	bool "dyndns-updater"
	help
	  Install dyndns-updater scripts set

	select BR2_PACKAGE_BASH

	select BR2_PACKAGE_BIND
	select BR2_PACKAGE_BIND_TOOLS

	select BR2_PACKAGE_CA_CERTIFICATES

	select BR2_PACKAGE_LIBCURL
	select BR2_PACKAGE_LIBCURL_CURL
```

## package/grepcidr/Config.in
```kconfig
config BR2_PACKAGE_GREPCIDR
	bool "grepcidr"
	help
	  Installing grepcidr utility
```

## package/pivpn/Config.in
```kconfig
config BR2_PACKAGE_PIVPN
	bool "pivpn"
	help
	  Installing pivpn, the simplest VPN installer designed for RPi

	select BR2_PACKAGE_COREUTILS
	select BR2_PACKAGE_EASY_RSA
	select BR2_PACKAGE_GAWK
	select BR2_PACKAGE_GETENT
	select BR2_PACKAGE_GREP
	select BR2_PACKAGE_GREPCIDR
	select BR2_PACKAGE_IPROUTE2
	select BR2_PACKAGE_IPTABLES
	select BR2_PACKAGE_PROCPS_NG
	select BR2_PACKAGE_NET_TOOLS
	select BR2_PACKAGE_UTIL_LINUX
	select BR2_PACKAGE_SED

	select BR2_PACKAGE_FINDUTILS
	select BR2_PACKAGE_SYSTEMD
	select BR2_PACKAGE_TAR
	select BR2_PACKAGE_GZIP

if BR2_PACKAGE_PIVPN

choice
	prompt "pivpn backend"

config BR2_PACKAGE_PIVPN_OPENVPN_BACKEND
	bool "openvpn"

	select BR2_PACKAGE_OPENVPN

config BR2_PACKAGE_PIVPN_WIREGUARD_BACKEND
	bool "wireguard"

	select BR2_PACKAGE_WIREGUARD

endchoice

config BR2_PACKAGE_PIVPN_BACKEND
	string
	default "openvpn" if BR2_PACKAGE_PIVPN_OPENVPN_BACKEND
	default "wireguard" if BR2_PACKAGE_PIVPN_WIREGUARD_BACKEND

endif
```
